#include "../../zmk-nodefree-config/keypos_def/keypos_36keys.h"

#define COMBO_TERM_FAST 35
#define COMBO_TERM_SLOW 40
#define COMBO_GLOBAL_QUICKTAP 100

&caps_word {
    continue-list = <
        UNDER MINUS BSPC
        LCTRL LALT LGUI LSHFT
        RCTRL RALT RGUI RSHFT
    >;
};

/ {
  combos {
    compatible = "zmk,combos";

    combo_capsword {
      timeout-ms = <COMBO_TERM_SLOW>;
      global-quick-tap-ms = <COMBO_GLOBAL_QUICKTAP>;

      key-positions = <LM1 RM1>;
      bindings = <&caps_word>;
    };
    
  };
};